/dts-v1/;
/plugin/;

/ {
    compatible = "rockchip,rk3588s-orangepi-5";

	fragment@0 {
		target = <&sata0>;

		__overlay__ {
			status = "okay";
		};
	};

	fragment@1 {
		target = <&pcie2x1l2>;

		__overlay__ {
			status = "disabled";
		};
	};
};
